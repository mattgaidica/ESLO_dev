/**
 * @cliArgs --board "/ti/boards/CC2652RB_LAUNCHXL" --product "simplelink_cc13x2_26x2_sdk@4.40.04.04"
 * @versions {"data":"2021010520","timestamp":"2021010520","tool":"1.7.0+1746","templates":null}
 */

/**
 * Import the modules used in this configuration.
 */
const ble         = scripting.addModule("/ti/ble5stack/ble");
const CCFG        = scripting.addModule("/ti/devices/CCFG");
const rfdesign    = scripting.addModule("/ti/devices/radioconfig/rfdesign");
const ADC         = scripting.addModule("/ti/drivers/ADC", {}, false);
const ADC1        = ADC.addInstance();
const ADC2        = ADC.addInstance();
const AESCCM      = scripting.addModule("/ti/drivers/AESCCM");
const AESCCM1     = AESCCM.addInstance();
const AESCTRDRBG  = scripting.addModule("/ti/drivers/AESCTRDRBG");
const AESCTRDRBG1 = AESCTRDRBG.addInstance();
const AESECB      = scripting.addModule("/ti/drivers/AESECB");
const AESECB1     = AESECB.addInstance();
const ECDH        = scripting.addModule("/ti/drivers/ECDH");
const ECDH1       = ECDH.addInstance();
const GPIO        = scripting.addModule("/ti/drivers/GPIO", {}, false);
const GPIO1       = GPIO.addInstance();
const GPIO2       = GPIO.addInstance();
const GPIO3       = GPIO.addInstance();
const GPIO4       = GPIO.addInstance();
const GPIO5       = GPIO.addInstance();
const GPIO6       = GPIO.addInstance();
const GPIO7       = GPIO.addInstance();
const GPIO8       = GPIO.addInstance();
const GPIO9       = GPIO.addInstance();
const GPIO10      = GPIO.addInstance();
const GPIO11      = GPIO.addInstance();
const I2C         = scripting.addModule("/ti/drivers/I2C", {}, false);
const I2C1        = I2C.addInstance();
const NVS         = scripting.addModule("/ti/drivers/NVS", {}, false);
const NVS1        = NVS.addInstance();
const Power       = scripting.addModule("/ti/drivers/Power");
const RF          = scripting.addModule("/ti/drivers/RF");
const RTOS        = scripting.addModule("/ti/drivers/RTOS");
const SPI         = scripting.addModule("/ti/drivers/SPI", {}, false);
const SPI1        = SPI.addInstance();
const SPI2        = SPI.addInstance();
const TRNG        = scripting.addModule("/ti/drivers/TRNG");
const TRNG1       = TRNG.addInstance();
const TRNG2       = TRNG.addInstance();

/**
 * Write custom configuration values to the imported modules.
 */
ble.lockProject                                           = true;
ble.tbmActiveItemsOnly                                    = false;
ble.disableDisplayModule                                  = true;
ble.maxPDUSize                                            = 255;
ble.deviceName                                            = "ESLO 001";
ble.maxConnNum                                            = 1;
ble.maxPDUNum                                             = 8;
ble.radioConfig.codeExportConfig.$name                    = "ti_devices_radioconfig_code_export_param0";
ble.connUpdateParamsPeripheral.$name                      = "ti_ble5stack_general_ble_conn_update_params0";
ble.advSet1.$name                                         = "ti_ble5stack_broadcaster_advertisement_set0";
ble.advSet1.advParam1.$name                               = "ti_ble5stack_broadcaster_advertisement_params0";
ble.advSet1.advParam1.primIntMin                          = 1000;
ble.advSet1.advParam1.primIntMax                          = 1000;
ble.advSet1.advData1.$name                                = "ti_ble5stack_broadcaster_advertisement_data0";
ble.advSet1.advData1.GAP_ADTYPE_FLAGS                     = true;
ble.advSet1.advData1.advertisingFlags                     = ["GAP_ADTYPE_FLAGS_BREDR_NOT_SUPPORTED","GAP_ADTYPE_FLAGS_GENERAL"];
ble.advSet1.advData1.GAP_ADTYPE_LOCAL_NAME_SHORT          = true;
ble.advSet1.advData1.GAP_ADTYPE_16BIT_MORE                = true;
ble.advSet1.advData1.numOfUUIDs16More                     = 1;
ble.advSet1.advData1.UUID016More                          = 0xE000;
ble.advSet1.advData1.shortenedLocalName                   = "ES001";
ble.advSet1.scanRes1.$name                                = "ti_ble5stack_broadcaster_advertisement_data1";
ble.advSet1.scanRes1.GAP_ADTYPE_LOCAL_NAME_COMPLETE       = true;
ble.advSet1.scanRes1.GAP_ADTYPE_SLAVE_CONN_INTERVAL_RANGE = true;
ble.advSet1.scanRes1.GAP_ADTYPE_POWER_LEVEL               = true;
ble.advSet1.scanRes1.completeLocalName                    = "ESLO 001";
ble.advSet1.scanRes1.minConnInterval                      = 20;
ble.advSet1.scanRes1.maxConnInterval                      = 30;
ble.advSet2.$name                                         = "ti_ble5stack_broadcaster_advertisement_set1";
ble.advSet2.advParam2.$name                               = "ti_ble5stack_broadcaster_advertisement_params1";
ble.advSet2.advParam2.advType                             = "extended";
ble.advSet2.advParam2.primIntMin                          = 1000;
ble.advSet2.advParam2.primIntMax                          = 1000;
ble.advSet2.advData2.$name                                = "ti_ble5stack_broadcaster_advertisement_data2";
ble.advSet2.advData2.GAP_ADTYPE_FLAGS                     = true;
ble.advSet2.advData2.advertisingFlags                     = ["GAP_ADTYPE_FLAGS_BREDR_NOT_SUPPORTED","GAP_ADTYPE_FLAGS_GENERAL"];
ble.advSet2.advData2.GAP_ADTYPE_LOCAL_NAME_SHORT          = true;
ble.advSet2.advData2.GAP_ADTYPE_16BIT_MORE                = true;
ble.advSet2.advData2.numOfUUIDs16More                     = 1;
ble.advSet2.advData2.UUID016More                          = 0xE000;
ble.advSet2.advData2.shortenedLocalName                   = "ES001";
ble.advSet2.scanRes2.$name                                = "ti_ble5stack_broadcaster_advertisement_data3";
ble.advSet2.scanRes2.GAP_ADTYPE_LOCAL_NAME_COMPLETE       = true;
ble.advSet2.scanRes2.GAP_ADTYPE_SLAVE_CONN_INTERVAL_RANGE = true;
ble.advSet2.scanRes2.GAP_ADTYPE_POWER_LEVEL               = true;
ble.advSet2.scanRes2.completeLocalName                    = "ESLO 001";
ble.advSet2.scanRes2.minConnInterval                      = 20;
ble.advSet2.scanRes2.maxConnInterval                      = 30;

CCFG.srcClkLF           = "LF RCOSC";
CCFG.enableDCDC         = false;
CCFG.ccfgTemplate.$name = "ti_devices_CCFGTemplate0";

ADC1.$name                = "THERM";
ADC1.adc.adcPin.$assign   = "boosterpack.6";
ADC1.adcPinInstance.$name = "CONFIG_PIN_20";

ADC2.$name                = "R_VBATT";
ADC2.adc.adcPin.$assign   = "boosterpack.23";
ADC2.adcPinInstance.$name = "CONFIG_PIN_4";

AESCCM1.$name = "CONFIG_AESCCM0";

AESCTRDRBG1.$name              = "CONFIG_AESCTRDRBG_0";
AESCTRDRBG1.aesctrObject.$name = "CONFIG_AESCTR_0";

AESECB1.$name = "CONFIG_AESECB0";

ECDH1.$name = "CONFIG_ECDH0";

GPIO1.$name             = "LED_0";
GPIO1.$hardware         = system.deviceData.board.components.LED_GREEN;
GPIO1.outputStrength    = "Low";
GPIO1.pinInstance.$name = "CONFIG_PIN_0";

GPIO2.$name                      = "_SHDN";
GPIO2.mode                       = "Output";
GPIO2.outputStrength             = "Low";
GPIO2.gpioPin.$assign            = "boosterpack.32";
GPIO2.pinInstance.$name          = "CONFIG_PIN_8";
GPIO2.pinInstance.outputStrength = "Minimum";

GPIO3.$name                      = "_FRAM_CS";
GPIO3.mode                       = "Output";
GPIO3.initialOutputState         = "High";
GPIO3.outputStrength             = "Low";
GPIO3.gpioPin.$assign            = "boosterpack.18";
GPIO3.pinInstance.$name          = "CONFIG_PIN_9";
GPIO3.pinInstance.outputStrength = "Minimum";

GPIO4.$name              = "_NAND_CS";
GPIO4.$hardware          = system.deviceData.board.components.MX25R8035F.subComponents.SELECT;
GPIO4.initialOutputState = "High";
GPIO4.outputStrength     = "Low";
GPIO4.pinInstance.$name  = "CONFIG_PIN_10";

GPIO5.$name              = "_EEG_CS";
GPIO5.initialOutputState = "High";
GPIO5.outputStrength     = "Low";
GPIO5.gpioPin.$assign    = "boosterpack.8";
GPIO5.pinInstance.$name  = "CONFIG_PIN_11";

GPIO6.$name                      = "EEG_START";
GPIO6.initialOutputState         = "High";
GPIO6.outputStrength             = "Low";
GPIO6.gpioPin.$assign            = "boosterpack.5";
GPIO6.pinInstance.$name          = "CONFIG_PIN_12";
GPIO6.pinInstance.outputStrength = "Minimum";

GPIO7.$name             = "_EEG_DRDY";
GPIO7.interruptTrigger  = "Falling Edge";
GPIO7.callbackFunction  = "eegDataReady";
GPIO7.gpioPin.$assign   = "boosterpack.2";
GPIO7.pinInstance.$name = "CONFIG_PIN_13";

GPIO8.interruptTrigger  = "Rising Edge";
GPIO8.callbackFunction  = "axyMagReady";
GPIO8.$name             = "AXY_MAG";
GPIO8.gpioPin.$assign   = "boosterpack.10";
GPIO8.pinInstance.$name = "CONFIG_PIN_15";

GPIO9.$name             = "AXY_INT1";
GPIO9.callbackFunction  = "axyXlReady";
GPIO9.interruptTrigger  = "Rising Edge";
GPIO9.gpioPin.$assign   = "boosterpack.19";
GPIO9.pinInstance.$name = "CONFIG_PIN_16";

GPIO10.$name             = "AXY_INT2";
GPIO10.$hardware         = system.deviceData.board.components["BTN-1"];
GPIO10.pull              = "None";
GPIO10.interruptTrigger  = "None";
GPIO10.pinInstance.$name = "CONFIG_PIN_17";
GPIO10.gpioPin.$assign   = "boosterpack.13";

GPIO11.$name             = "DEBUG";
GPIO11.$hardware         = system.deviceData.board.components["BTN-2"];
GPIO11.interruptTrigger  = "None";
GPIO11.pinInstance.$name = "CONFIG_PIN_21";
GPIO11.gpioPin.$assign   = "boosterpack.12";

I2C1.$name                = "CONFIG_I2C_AXY";
I2C1.i2c.sdaPin.$assign   = "boosterpack.30";
I2C1.i2c.sclPin.$assign   = "boosterpack.29";
I2C1.sdaPinInstance.$name = "CONFIG_PIN_18";
I2C1.sdaPinInstance.pull  = "None";
I2C1.clkPinInstance.$name = "CONFIG_PIN_19";
I2C1.clkPinInstance.pull  = "None";

NVS1.$name                    = "CONFIG_NVSINTERNAL";
NVS1.internalFlash.$name      = "ti_drivers_nvs_NVSCC26XX0";
NVS1.internalFlash.regionBase = 0x48000;
NVS1.internalFlash.regionSize = 0x4000;

Power.calibrateRCOSC_HF = false;

RF.xoscNeeded = false;

SPI1.$hardware             = system.deviceData.board.components.LP_SPI;
SPI1.$name                 = "CONFIG_SPI";
SPI1.sclkPinInstance.$name = "CONFIG_PIN_1";
SPI1.sclkPinInstance.mode  = "Input";
SPI1.misoPinInstance.$name = "CONFIG_PIN_2";
SPI1.mosiPinInstance.$name = "CONFIG_PIN_3";
SPI1.mosiPinInstance.mode  = "Input";

SPI2.$name                 = "CONFIG_SPI_EEG";
SPI2.spi.sclkPin.$assign   = "boosterpack.37";
SPI2.spi.misoPin.$assign   = "boosterpack.31";
SPI2.spi.mosiPin.$assign   = "boosterpack.36";
SPI2.sclkPinInstance.$name = "CONFIG_PIN_5";
SPI2.sclkPinInstance.mode  = "Input";
SPI2.misoPinInstance.$name = "CONFIG_PIN_6";
SPI2.mosiPinInstance.$name = "CONFIG_PIN_7";
SPI2.mosiPinInstance.mode  = "Input";

TRNG1.$name = "CONFIG_TRNG_0";

TRNG2.$name = "CONFIG_TRNG_1";

/**
 * Pinmux solution for unlocked pins/peripherals. This ensures that minor changes to the automatic solver in a future
 * version of the tool will not impact the pinmux you originally saw.  These lines can be completely deleted in order to
 * re-solve from scratch.
 */
ADC1.adc.$suggestSolution              = "ADC0";
ADC2.adc.$suggestSolution              = "ADC0";
GPIO1.gpioPin.$suggestSolution         = "boosterpack.40";
GPIO4.gpioPin.$suggestSolution         = "boosterpack.38";
I2C1.i2c.$suggestSolution              = "I2C0";
SPI1.spi.$suggestSolution              = "SSI0";
SPI1.spi.sclkPin.$suggestSolution      = "boosterpack.7";
SPI1.spi.misoPin.$suggestSolution      = "boosterpack.14";
SPI1.spi.mosiPin.$suggestSolution      = "boosterpack.15";
SPI1.spi.dmaRxChannel.$suggestSolution = "DMA_CH3";
SPI1.spi.dmaTxChannel.$suggestSolution = "DMA_CH4";
SPI2.spi.$suggestSolution              = "SSI1";
SPI2.spi.dmaRxChannel.$suggestSolution = "DMA_CH16";
SPI2.spi.dmaTxChannel.$suggestSolution = "DMA_CH17";
