/**
 * @cliArgs --board "/ti/boards/CC2652RB_LAUNCHXL" --product "simplelink_cc13x2_26x2_sdk@4.30.00.54"
 * @versions {"data":"2020090214","timestamp":"2020090214","tool":"1.6.0+1543","templates":"2020090214"}
 */

/**
 * Import the modules used in this configuration.
 */
const CCFG  = scripting.addModule("/ti/devices/CCFG");
const DMA   = scripting.addModule("/ti/drivers/DMA");
const GPIO  = scripting.addModule("/ti/drivers/GPIO");
const GPIO1 = GPIO.addInstance();
const GPIO2 = GPIO.addInstance();
const RTOS  = scripting.addModule("/ti/drivers/RTOS");

/**
 * Write custom configuration values to the imported modules.
 */
CCFG.srcClkLF           = "LF RCOSC";
CCFG.ccfgTemplate.$name = "ti_devices_CCFGTemplate0";

GPIO1.$name             = "CONFIG_GPIO_LED_0";
GPIO1.$hardware         = system.deviceData.board.components.LED_GREEN;
GPIO1.outputStrength    = "Low";
GPIO1.pinInstance.$name = "CONFIG_PIN_0";

GPIO2.$name             = "_SHDN";
GPIO2.mode              = "Output";
GPIO2.outputStrength    = "Low";
GPIO2.gpioPin.$assign   = "boosterpack.32";
GPIO2.pinInstance.$name = "CONFIG_PIN_1";

/**
 * Pinmux solution for unlocked pins/peripherals. This ensures that minor changes to the automatic solver in a future
 * version of the tool will not impact the pinmux you originally saw.  These lines can be completely deleted in order to
 * re-solve from scratch.
 */
GPIO1.gpioPin.$suggestSolution = "boosterpack.40";
