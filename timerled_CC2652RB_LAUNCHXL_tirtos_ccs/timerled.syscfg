/**
 * @cliArgs --board "/ti/boards/CC2652RB_LAUNCHXL" --product "simplelink_cc13x2_26x2_sdk@4.40.00.44"
 * @versions {"data":"2021010520","timestamp":"2021010520","tool":"1.7.0+1746","templates":null}
 */

/**
 * Import the modules used in this configuration.
 */
const GPIO   = scripting.addModule("/ti/drivers/GPIO");
const GPIO1  = GPIO.addInstance();
const RTOS   = scripting.addModule("/ti/drivers/RTOS");
const Timer  = scripting.addModule("/ti/drivers/Timer");
const Timer1 = Timer.addInstance();

/**
 * Write custom configuration values to the imported modules.
 */
GPIO1.$name             = "CONFIG_GPIO_LED_0";
GPIO1.$hardware         = system.deviceData.board.components.LED_GREEN;
GPIO1.pinInstance.$name = "CONFIG_PIN_0";

const CCFG              = scripting.addModule("/ti/devices/CCFG", {}, false);
CCFG.ccfgTemplate.$name = "ti_devices_CCFGTemplate0";

Timer1.$name               = "CONFIG_TIMER_0";
Timer1.timerType           = "32 Bits";
Timer1.timerInstance.$name = "CONFIG_GPTIMER_0";

/**
 * Pinmux solution for unlocked pins/peripherals. This ensures that minor changes to the automatic solver in a future
 * version of the tool will not impact the pinmux you originally saw.  These lines can be completely deleted in order to
 * re-solve from scratch.
 */
GPIO1.gpioPin.$suggestSolution              = "boosterpack.40";
Timer1.timerInstance.timer.$suggestSolution = "GPTM0";
