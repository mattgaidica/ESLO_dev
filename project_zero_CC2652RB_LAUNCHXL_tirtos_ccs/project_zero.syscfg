/**
 * @cliArgs --board "/ti/boards/CC2652RB_LAUNCHXL" --product "simplelink_cc13x2_26x2_sdk@4.30.00.54"
 * @versions {"data":"2020090214","timestamp":"2020090214","tool":"1.6.0+1543","templates":"2020090214"}
 */

/**
 * Import the modules used in this configuration.
 */
const ble         = scripting.addModule("/ti/ble5stack/ble");
const CCFG        = scripting.addModule("/ti/devices/CCFG");
const rfdesign    = scripting.addModule("/ti/devices/radioconfig/rfdesign");
const AESCCM      = scripting.addModule("/ti/drivers/AESCCM");
const AESCCM1     = AESCCM.addInstance();
const AESCTRDRBG  = scripting.addModule("/ti/drivers/AESCTRDRBG");
const AESCTRDRBG1 = AESCTRDRBG.addInstance();
const AESECB      = scripting.addModule("/ti/drivers/AESECB");
const AESECB1     = AESECB.addInstance();
const ECDH        = scripting.addModule("/ti/drivers/ECDH");
const ECDH1       = ECDH.addInstance();
const GPIO        = scripting.addModule("/ti/drivers/GPIO");
const GPIO1       = GPIO.addInstance();
const GPIO2       = GPIO.addInstance();
const GPIO3       = GPIO.addInstance();
const GPIO4       = GPIO.addInstance();
const GPIO5       = GPIO.addInstance();
const GPIO6       = GPIO.addInstance();
const GPIO7       = GPIO.addInstance();
const NVS         = scripting.addModule("/ti/drivers/NVS");
const NVS1        = NVS.addInstance();
const Power       = scripting.addModule("/ti/drivers/Power");
const RF          = scripting.addModule("/ti/drivers/RF");
const RTOS        = scripting.addModule("/ti/drivers/RTOS");
const TRNG        = scripting.addModule("/ti/drivers/TRNG");
const TRNG1       = TRNG.addInstance();

/**
 * Write custom configuration values to the imported modules.
 */
ble.lockProject                                     = true;
ble.deviceName                                      = "Project Zero BAW";
ble.addressMode                                     = "ADDRMODE_PUBLIC";
ble.disableDisplayModule                            = true;
ble.uartLog                                         = true;
ble.maxPDUSize                                      = 251;
ble.maxConnNum                                      = 2;
ble.numOfAdvSets                                    = 1;
ble.numOfDefAdvSets                                 = 1;
ble.defaultTxPower                                  = "HCI_EXT_TX_POWER_MINUS_10_DBM";
ble.radioConfig.codeExportConfig.$name              = "ti_devices_radioconfig_code_export_param0";
ble.connUpdateParamsPeripheral.$name                = "ti_ble5stack_general_ble_conn_update_params0";
ble.connUpdateParamsPeripheral.reqConnTo            = 2000;
ble.connUpdateParamsPeripheral.reqMaxConnInt        = 45;
ble.connUpdateParamsPeripheral.reqMinConnInt        = 15;
ble.advSet1.$name                                   = "ti_ble5stack_broadcaster_advertisement_set0";
ble.advSet1.advParam1.$name                         = "ti_ble5stack_broadcaster_advertisement_params0";
ble.advSet1.advData1.$name                          = "ti_ble5stack_broadcaster_advertisement_data0";
ble.advSet1.advData1.GAP_ADTYPE_FLAGS               = true;
ble.advSet1.advData1.advertisingFlags               = ["GAP_ADTYPE_FLAGS_BREDR_NOT_SUPPORTED","GAP_ADTYPE_FLAGS_GENERAL"];
ble.advSet1.advData1.GAP_ADTYPE_LOCAL_NAME_COMPLETE = true;
ble.advSet1.advData1.completeLocalName              = "Project Zero BAW";
ble.advSet1.scanRes1.$name                          = "ti_ble5stack_broadcaster_advertisement_data1";
ble.advSet1.scanRes1.GAP_ADTYPE_128BIT_MORE         = true;
ble.advSet1.scanRes1.numOfUUIDs128More              = 1;
ble.advSet1.scanRes1.UUID0128More                   = system.utils.bigInt("B000405104101100F0",16);

CCFG.enableCodeGeneration = false;
CCFG.enableDCDC           = false;
CCFG.srcClkLF             = "LF RCOSC";
CCFG.ccfgTemplate.$name   = "ti_devices_CCFGTemplateInit0";

AESCCM1.$name = "CONFIG_AESCCM0";

AESCTRDRBG1.$name              = "CONFIG_AESCTRDRBG_0";
AESCTRDRBG1.aesctrObject.$name = "CONFIG_AESCTR_0";

AESECB1.$name = "CONFIG_AESECB0";

ECDH1.$name = "CONFIG_ECDH0";

GPIO1.$hardware         = system.deviceData.board.components["BTN-1"];
GPIO1.mode              = "Dynamic";
GPIO1.$name             = "CONFIG_GPIO_BTN1";
GPIO1.pinInstance.$name = "CONFIG_PIN_BTN1";

GPIO2.$hardware         = system.deviceData.board.components["BTN-2"];
GPIO2.mode              = "Dynamic";
GPIO2.$name             = "CONFIG_GPIO_BTN2";
GPIO2.pinInstance.$name = "CONFIG_PIN_BTN2";

GPIO3.$hardware         = system.deviceData.board.components.LED_RED;
GPIO3.mode              = "Dynamic";
GPIO3.$name             = "CONFIG_GPIO_RLED";
GPIO3.pinInstance.$name = "CONFIG_PIN_RLED";

GPIO4.$hardware         = system.deviceData.board.components.LED_GREEN;
GPIO4.mode              = "Dynamic";
GPIO4.$name             = "CONFIG_GPIO_GLED";
GPIO4.pinInstance.$name = "CONFIG_PIN_GLED";

GPIO5.$name             = "_SHDN";
GPIO5.mode              = "Output";
GPIO5.outputStrength    = "Low";
GPIO5.gpioPin.$assign   = "boosterpack.32";
GPIO5.pinInstance.$name = "CONFIG_PIN_4";

GPIO6.$name             = "_EEG_CS";
GPIO6.gpioPin.$assign   = "boosterpack.8";
GPIO6.pinInstance.$name = "CONFIG_PIN_5";

GPIO7.$name             = "EEG_START";
GPIO7.gpioPin.$assign   = "boosterpack.5";
GPIO7.pinInstance.$name = "CONFIG_PIN_6";

NVS1.$name                    = "CONFIG_NVSINTERNAL";
NVS1.internalFlash.$name      = "ti_drivers_nvs_NVSCC26XX0";
NVS1.internalFlash.regionBase = 0x48000;
NVS1.internalFlash.regionSize = 0x4000;

Power.calibrateRCOSC_HF = false;

RF.xoscNeeded = false;

TRNG1.$name = "CONFIG_TRNG_0";

/**
 * Pinmux solution for unlocked pins/peripherals. This ensures that minor changes to the automatic solver in a future
 * version of the tool will not impact the pinmux you originally saw.  These lines can be completely deleted in order to
 * re-solve from scratch.
 */
GPIO1.gpioPin.$suggestSolution = "boosterpack.13";
GPIO2.gpioPin.$suggestSolution = "boosterpack.12";
GPIO3.gpioPin.$suggestSolution = "boosterpack.39";
GPIO4.gpioPin.$suggestSolution = "boosterpack.40";
